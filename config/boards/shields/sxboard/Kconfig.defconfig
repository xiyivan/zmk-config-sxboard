## config/boards/shields/sxboard/Kconfig.defconfig
```kconfig
if SHIELD_SXBOARD_LEFT

config ZMK_KEYBOARD_NAME
    default "sxboard"

config ZMK_SPLIT_ROLE_CENTRAL
    default y

endif

if SHIELD_SXBOARD_LEFT || SHIELD_SXBOARD_RIGHT

config ZMK_SPLIT
    default y

endif
```

## config/boards/shields/sxboard/Kconfig.shield
```kconfig
config SHIELD_SXBOARD_LEFT
    def_bool $(shields_list_contains,sxboard_left)

config SHIELD_SXBOARD_RIGHT
    def_bool $(shields_list_contains,sxboard_right)
```
